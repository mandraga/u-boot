## configs/A33-ZortraxM200Plus_defconfig
```kconfig
CONFIG_ARM=y
CONFIG_ARCH_SUNXI=y
CONFIG_DEFAULT_DEVICE_TREE="sun8i-a33-zortrax-m200plus"
CONFIG_SPL=y
CONFIG_MACH_SUN8I_A33=y
## RAM and Power parameters
CONFIG_DRAM_CLK=552
CONFIG_DRAM_ZQ=15291
#CONFIG_DRAM_ODT_EN=y
#CONFIG_DRAM_PARA1=284295680
#CONFIG_DRAM_PARA2=0
#CONFIG_DRAM_MR0=6208
#CONFIG_DRAM_MR1=64
#CONFIG_DRAM_MR2=8
#CONFIG_DRAM_MR3=0
#CONFIG_DRAM_TPR0=0x48a192
#CONFIG_DRAM_TPR1=0x1b1b18d
#CONFIG_DRAM_TPR2=0x76052
#CONFIG_DRAM_TPR3=0x0
#CONFIG_DRAM_TPR4=0x0
#CONFIG_DRAM_TPR5=0x0
#CONFIG_DRAM_TPR6=0x0
#CONFIG_DRAM_TPR7=0x0
#CONFIG_DRAM_TPR8=0x0
#CONFIG_DRAM_TPR9=0x0
#CONFIG_DRAM_TPR10=0x0
#CONFIG_DRAM_TPR11=0x0
#CONFIG_DRAM_TPR12=0xa8
#CONFIG_DRAM_TPR13=0x10900
# MMC
CONFIG_DM_MMC=y
CONFIG_MMC_SPEED_MODE_SET=y
## This is the default Zortrax sunxi env in emmc
## emmcstart.img5        139264   172031    32768   16M 83 Linux       env          uboot env, text
#CONFIG_ENV_IS_IN_MMC=y
#CONFIG_ENV_OFFSET=71303168
#CONFIG_ENV_SIZE=0x1000000
## This uses the fat16 partition to store our u-boot env
#CONFIG_ENV_IS_IN_FAT=y
#CONFIG_ENV_FAT_DEVICE_AND_PART="2:2"
#CONFIG_ENV_FAT_FILE="uboot.env"

CONFIG_UART0_PORT_F=y
CONFIG_BOOTCOMMAND="setenv bootargs root=/dev/mmcblk2p1 rootwait console=ttyS0,115200 fbcon=rotate:3 rw; \
usb start; \
ext4load usb 0:2 0x42000000 boot/zImage; \
ext4load usb 0:1 0x43000000 sun8i-a33-zortrax-m200plus.dtb; \
bootz 0x42000000 - 0x43000000"
#CONFIG_EXTRA_ENV_SETTINGS="fel_mode=mw.l 0x01f00108 0x5aa5a55a 1; reset"
## USB
CONFIG_USB_EHCI_HCD=y
CONFIG_USB_OHCI_HCD=y
CONFIG_USB_FUNCTION_MASS_STORAGE=y
CONFIG_CMD_USB_MASS_STORAGE=y
CONFIG_USB_MUSB_GADGET=y
# Trade off mass storage and usb host
CONFIG_USB_MUSB_HOST=y
#CONFIG_USB_OTG=y
CONFIG_AXP221_POWER=y
CONFIG_AXP221_DCDC1=3000
CONFIG_AXP221_DCDC2=1100
CONFIG_AXP221_DCDC3=1200
CONFIG_AXP221_DCDC4=0
CONFIG_AXP221_DCDC5=1500
CONFIG_AXP221_ALDO2=2500
CONFIG_AXP221_ALDO3=3000
CONFIG_AXP221_ELDO1=1800
CONFIG_AXP221_ELDO2=1800
CONFIG_AXP221_DLDO2=1800
#CONFIG_LOG=y
#CONFIG_LOGLEVEL=7
#CONFIG_LOG_MAX_LEVEL=7
#CONFIG_LOG_CONSOLE=y
#CONFIG_MMC_TRACE=y
#CONFIG_ANDROID_BOOT_IMAGE=y
#CONFIG_CMD_BOOTI=y
#CONFIG_CMD_ABOOTIMG=y
#CONFIG_CMD_ADTIMG=y

CONFIG_FS_EXT4=y
CONFIG_BOOTDELAY=1
# To load uboot mainline from sunxi legacy boot0 stage (need a script to pack the data).
#CONFIG_TEXT_BASE=0x4a000500
```

## configs/A33-ZortraxM200_defconfig
```kconfig
CONFIG_ARM=y
CONFIG_ARCH_SUNXI=y
CONFIG_DEFAULT_DEVICE_TREE="sun8i-a33-zortrax-m200"
CONFIG_SPL=y
CONFIG_MACH_SUN8I_A33=y
CONFIG_DRAM_CLK=552
CONFIG_DRAM_ZQ=15291
#CONFIG_DRAM_ODT_EN=y
#CONFIG_MMC_SUNXI_SLOT_EXTRA=2
CONFIG_UART0_PORT_F=y
#CONFIG_VIDEO_LCD_MODE="x:800,y:480,depth:18,pclk_khz:33000,le:16,ri:209,up:22,lo:22,hs:30,vs:1,sync:3,vmode:0"
#CONFIG_VIDEO_LCD_DCLK_PHASE=0
#CONFIG_VIDEO_LCD_BL_EN="PB2"
#CONFIG_VIDEO_LCD_BL_PWM="PH0"
CONFIG_USB_EHCI_HCD=y
CONFIG_USB_OHCI_HCD=y
CONFIG_USB_FUNCTION_MASS_STORAGE=y
CONFIG_USB_NET=y
CONFIG_USB_NET_RTL8152=y  
CONFIG_USB_MUSB_GADGET=y
#CONFIG_USB_OTG=y
CONFIG_AXP221_POWER=y
CONFIG_AXP_GPIO=y
CONFIG_LOG=y
#CONFIG_LOGLEVEL=7
#CONFIG_LOG_MAX_LEVEL=7
#CONFIG_LOG_CONSOLE=y
CONFIG_ANDROID_BOOT_IMAGE=y
CONFIG_CMD_BOOTI=y
CONFIG_CMD_ABOOTIMG=y
CONFIG_CMD_ADTIMG=y
CONFIG_MMC_SUNXI_SLOT_EXTRA=1
CONFIG_FS_EXT4=y
```

## configs/A33_ezeetab_defconfig
```kconfig
CONFIG_ARM=y
CONFIG_ARCH_SUNXI=y
CONFIG_DEFAULT_DEVICE_TREE="sun8i-a33-ezeetab"
CONFIG_DRAM_CLK=456
CONFIG_SPL=y
CONFIG_MACH_SUN8I_A33=y
CONFIG_DRAM_ZQ=15291
# CONFIG_SYS_MALLOC_CLEAR_ON_INIT is not set
#CONFIG_REGULATOR_AXP_DRIVEVBUS=y
#CONFIG_REGULATOR_AXP_USB_POWER=y
CONFIG_AXP_DLDO1_VOLT=3300
CONFIG_CONS_INDEX=5
#CONFIG_USB_MUSB_HOST=y
CONFIG_CMD_USB_MASS_STORAGE=y
CONFIG_USB_MUSB_GADGET=y
```
